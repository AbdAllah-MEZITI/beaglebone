## dev/buildroot/package/khaymatec/Config.in
```kconfig
menu "KhaymaTec packages"
     source "package/khaymatec/ledflash/Config.in"
endmenu
```

## dev/buildroot/package/khaymatec/ledflash/Config.in
```kconfig
config BR2_PACKAGE_LED_FLASH_MODULE
       bool "Led flash module"
       depends on BR2_LINUX_KERNEL
       help
	Kernel module to support LED flash.
comment "LED flash module requires a linx kernel to be built"
	depends on !BR2_LINUX_KERNEL
```

## dev/buildroot_project/package/hello/Config.in
```kconfig
config BR2_PACKAGE_HELLO
       bool "hello"
       help
         This is the hello module
```

## dev/buildroot_project/package/ledflash/Config.in
```kconfig
config BR2_PACKAGE_LEDFLASH
	bool "Led flash module"
#	default y
#	depends on BR2_LINUX_KERNEL
	help
		Kernel module to support LED flash.

#comment "LED flash module requires a linux kernel to be built"
#	depends on !BR2_LINUX_KERNEL
```
